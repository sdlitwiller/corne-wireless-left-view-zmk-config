/*
 * Custom overlay for split-status display behavior on a single nice!view.
 * This provides a local widget node that advertises split battery status support
 * for the left-side screen so the firmware can render both halves.
 */

/ {
    chosen {
        zmk,battery-status-widget = &battery_status_widget;
    };

    battery_status_widget: battery_status_widget {
        compatible = "zmk,battery-status";
        status = "okay";
        split-battery = <1>;
        display-name = "split-battery";
        label = "L/R";
    };
};
